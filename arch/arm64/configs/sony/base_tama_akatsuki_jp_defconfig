## arch/arm64/configs/sony/base_tama_akatsuki_jp_defconfig
```kconfig
CONFIG_MACH_SONY_AKATSUKI_JP=y
CONFIG_INPUT_QTI_HAPTICS=y
CONFIG_INPUT_BU520X1NVX=y
CONFIG_TOUCHSCREEN_ATMEL_MXT640U=y
CONFIG_IDTP9221=y
# CONFIG_NFC_NQ is not set
# CONFIG_NFC_PN553_DEVICES is not set
CONFIG_NFC_CARILLON=y
```

## arch/arm64/configs/sony/base_tama_aurora_jp_defconfig
```kconfig
CONFIG_MACH_SONY_AURORA_JP=y
CONFIG_INPUT_QTI_HAPTICS=y
CONFIG_INPUT_BU520X1NVX=y
# CONFIG_TOUCHSCREEN_SYNAPTICS_TCM is not set
CONFIG_TOUCHSCREEN_SIW=y
CONFIG_TOUCHSCREEN_SIW_SW49501=y
CONFIG_TOUCHSCREEN_SIWMON=y
CONFIG_IDTP9221=y
# CONFIG_NFC_NQ is not set
# CONFIG_NFC_PN553_DEVICES is not set
CONFIG_NFC_CARILLON=y
```
